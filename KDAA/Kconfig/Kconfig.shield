## KDAA/Kconfig/arch/Kconfig
```kconfig
# Load Zephyr Arch Kconfig descriptions.
osource "/opt/nordic/ncs/v2.9.2/zephyr/arch/x86/Kconfig"
osource "/opt/nordic/ncs/v2.9.2/zephyr/arch/xtensa/Kconfig"
osource "/opt/nordic/ncs/v2.9.2/zephyr/arch/sparc/Kconfig"
osource "/opt/nordic/ncs/v2.9.2/zephyr/arch/riscv/Kconfig"
osource "/opt/nordic/ncs/v2.9.2/zephyr/arch/posix/Kconfig"
osource "/opt/nordic/ncs/v2.9.2/zephyr/arch/nios2/Kconfig"
osource "/opt/nordic/ncs/v2.9.2/zephyr/arch/mips/Kconfig"
osource "/opt/nordic/ncs/v2.9.2/zephyr/arch/arm64/Kconfig"
osource "/opt/nordic/ncs/v2.9.2/zephyr/arch/arm/Kconfig"
osource "/opt/nordic/ncs/v2.9.2/zephyr/arch/arc/Kconfig"
```

## KDAA/Kconfig/boards/Kconfig
```kconfig
# Load Zephyr board Kconfig descriptions.
osource "/opt/nordic/ncs/v2.9.2/zephyr/boards/nordic/nrf54l15dk/Kconfig"
```

## KDAA/Kconfig/boards/Kconfig.defconfig
```kconfig
# Load Zephyr board defconfig descriptions.
osource "/opt/nordic/ncs/v3.2.4/zephyr/boards/nordic/nrf54lm20dk/Kconfig.defconfig"
```

## KDAA/Kconfig/boards/Kconfig.sysbuild
```kconfig
# Load Sysbuild board Kconfig descriptions.
osource "/opt/nordic/ncs/v3.2.4/zephyr/boards/nordic/nrf54lm20dk/Kconfig.sysbuild"
```

## build_1/Kconfig/boards/Kconfig.defconfig
```kconfig
# Load Zephyr board defconfig descriptions.
osource "C:/ncs/v2.9.2/zephyr/boards/nordic/nrf54l15dk/Kconfig.defconfig"
```

## movetest/Kconfig/arch/Kconfig.tmp
```kconfig
# Load Zephyr Arch Kconfig descriptions.
osource "D:/ncs/v3.3.0/zephyr/arch/rx/Kconfig"
osource "D:/ncs/v3.3.0/zephyr/arch/x86/Kconfig"
osource "D:/ncs/v3.3.0/zephyr/arch/xtensa/Kconfig"
osource "D:/ncs/v3.3.0/zephyr/arch/sparc/Kconfig"
osource "D:/ncs/v3.3.0/zephyr/arch/riscv/Kconfig"
osource "D:/ncs/v3.3.0/zephyr/arch/posix/Kconfig"
osource "D:/ncs/v3.3.0/zephyr/arch/mips/Kconfig"
osource "D:/ncs/v3.3.0/zephyr/arch/arm64/Kconfig"
osource "D:/ncs/v3.3.0/zephyr/arch/arm/Kconfig"
osource "D:/ncs/v3.3.0/zephyr/arch/arc/Kconfig"
```

## movetest/Klaviator-Firmware/Kconfig/boards/Kconfig.nrf54lm20dk
```kconfig
# Load board Kconfig descriptions.
osource "D:/ncs/v3.3.0/zephyr/boards/nordic/nrf54lm20dk/Kconfig.nrf54lm20dk"
```

## nyestebuild/Kconfig/boards/Kconfig
```kconfig
# Load Zephyr board Kconfig descriptions.
osource "D:/ncs/v3.3.0/zephyr/boards/nordic/nrf54lm20dk/Kconfig"
```
